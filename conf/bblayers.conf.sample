## conf/bblayers.conf.sample
```bitbake
# derived from poky
POKY_BBLAYERS_CONF_VERSION = "2"

BBPATH = "${TOPDIR}"
BBFILES ?= ""

BBLAYERS ?= " \
  ##OEROOT##/meta \
  ##OEROOT##/meta-manaos \
  ##OEROOT##/meta-yocto-bsp \
  ##OEROOT##/meta-openembedded/meta-oe \
  ##OEROOT##/meta-openembedded/meta-networking \
  ##OEROOT##/meta-openembedded/meta-python \
  "
```

## conf/distro/manaos.conf
```bitbake
include conf/distro/poky.conf
DISTRO = "manaos"
DISTRO_NAME = "manaOS-Linux"
DISTRO_VERSION = "1.0"
DISTRO_CODENAME = "thud"
SDK_VENDOR = "-manaossdk"
SDK_VERSION=""
MAINTAINER = "maint@example.com"

TARGET_VENDOR = "-manaos"

MANAOS_DEFAULT_DISTRO_FEATURES = "ext2 largefile usbhost pci"
MANAOS_DEFAULT_EXTRA_RDEPENDS = "packagegroup-core-boot"
MANAOS_DEFAULT_EXTRA_RRECOMMENDS = "kernel-module-af-packet"

DISTRO_EXTRA_RDEPENDS += " "
DISTRO_EXTRA_RRECOMMENDS += " "

DISTRO_FEATURES ?= " ipv6"
DISTRO_FEATURES_remove = " opengl wayland x11 vulkan alsa pulseaudio"

PACKAGE_CLASSES = "package_deb"

#DISTRO_FEATURES_append = " systemd"
#DISTRO_FEATURES_BACKFILL_CONSIDERED += "sysvinit"
#VIRTUAL-RUNTIME_init_manager = "systemd"
#VIRTUAL-RUNTIME_initscripts = "systemd-compat-units"
```

## conf/local.conf.sample
```bitbake
CONF_VERSION = "1"

MACHINE ?= "qemux86-64"
# TODO: this probably doesn't belong here, need it for iwlwifi:
MACHINE_ESSENTIAL_EXTRA_RRECOMMENDS += "kernel-modules"
DISTRO ?= "manaos"
EXTRA_IMAGE_FEATURES ?= "debug-tweaks ssh-server-dropbear"
# TODO: move these to a package group
CORE_IMAGE_EXTRA_INSTALL += " python3 python3-pip python screen curl vim-tiny iproute2 iptables htop iperf3 curl sqlite3 sudo usbutils gnupg iw haveged nmap hostapd mtr tcpdump bridge-utils e2fsprogs uwsgi minimodem magicmodem-init magicmodem dnsmasq lcdproc linux-firmware-iwlwifi-7260"
USER_CLASSES ?= "buildstats image-mklibs image-prelink"
PATCHRESOLVE = "noop"
PACKAGECONFIG_append_pn-qemu-native = " sdl"
PACKAGECONFIG_append_pn-nativesdk-qemu = " sdl"

# recipe overrides
hostname_pn-base-files = "magicmodem"

# Keep the poky disk space monitoring limits
BB_DISKMON_DIRS ??= "\
    STOPTASKS,${TMPDIR},1G,100K \
    STOPTASKS,${DL_DIR},1G,100K \
    STOPTASKS,${SSTATE_DIR},1G,100K \
    STOPTASKS,/tmp,100M,100K \
    ABORT,${TMPDIR},100M,1K \
    ABORT,${DL_DIR},100M,1K \
    ABORT,${SSTATE_DIR},100M,1K \
    ABORT,/tmp,10M,1K"

INHERIT += "buildhistory"
BUILDHISTORY_COMMIT = "1"
#IMAGE_INSTALL_append = " "

# add an extra 10MB to the image
IMAGE_ROOTFS_EXTRA_SPACE = "10240"
```
